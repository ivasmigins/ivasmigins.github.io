## public_projects/WifiManagerESP32/main/Kconfig.projbuild
```kconfig
menu "WiFi Settings"
    config WIFI_SSID
        string "SSID"
        default "iPhone"
    config WIFI_PASS
        string "Password"
        default "Contrasena321"
endmenu
```
